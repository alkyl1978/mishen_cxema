

;***************************************************************************************
;	 Обработка прерывания *USART, приём завершен*
;***************************************************************************************

RS_in:	WDR			;Сброс сторожевого таймера
	IN	R10,SREG		;Сохранить состояние регистра статуса
	LDS	R20,UDR0		;Прочесть байт из приемника USART
	MOV	R21,R11		;Счётчик принятых байт по каналу USART
	LDI	R30,LOW(Buf_in)	;Буфер принимаемых данных по USART
	LDI	R31,HIGH(Buf_in)
	ADD	R30,R21
	ADC	R31,R8
	ST	Z,R20		;Записать принятый байт в ОЗУ
	INC	R21
	MOV	R11,R21		;Счётчик принятых байт по каналу USART
	CPI	R21,$07
	BRCC	RS_in_1		;Принято меньше 6 байт ?
	RJMP	RS_ks		;Подсчет контрольной суммы
RS_in_1:	CPI	R21,$08
	BRCS	RS_ks2		;Принято меньше 7 байт ?
	LDS	R31,Buf_in+6
	LDS	R30,Buf_in+7	;Контрольня сумма принятых в данных по USART
	LDI	R20,$AA
	CP	R30,R12	
	CPC	R31,R13
	BRNE	RS_in_2
	LDI	R20,$55
RS_in_2:	OUT	GPIOR1,R20		;Флаг указатель - данные по каналу USART приняты ($55)
	RJMP	Recept		;Настроить USART на приём данных

;***************************************************************************************
;	 Регистр данных USART пуст
;***************************************************************************************

RS_out:	WDR			;Сброс сторожевого таймера
	IN	R10,SREG		;Сохранить состояние регистра статуса
	IN	R21,GPIOR2		;Счётчик передаваемых байт
	TST	R21
	BRMI	RS_out_2
	BREQ	RS_out_1
	RJMP	RS_out_3
RS_out_1:	STS	UDR0,R13		;Записать ст.байт КС в буфер передатчика USART
	SUBI	R21,1
	OUT	GPIOR2,R21		;Счётчик передаваемых байт
	RJMP	RS_ks2
RS_out_2:	STS	UDR0,R12		;Записать мл.байт КС в буфер передатчика USART
	LDI	R20,$48		;Разрешить передачу и прерывания
	STS	UCSR0B,R20		; по завершении передачи USART
	RJMP	RS_ks2
RS_out_3:	SUBI	R21,1
	OUT	GPIOR2,R21		;Счётчик передаваемых байт
	MOVW	R31:R30,R15:R14	;Текущий адрес месторасположения передаваемых байт
	LD	R20,Z+
	STS	UDR0,R20		;Записать байт в буфер передатчика USART
	MOVW	R15:R14,R31:R30	;Сохранить - Адрес данных передаваемых по USART

;***************************************************************************************
;	 Подсчет контрольной суммы (в R20 входной байт)
;***************************************************************************************

RS_ks:	EOR	R12,R20
	LDI	R20,$09
	LDI	R30,$01
	LDI	R31,$A0      	;Полином A001 в R21, R20
RS_ks1:	DEC	R20
	BREQ	RS_ks2
	LSR	R13
	ROR	R12
	BRCC	RS_ks1
	EOR	R12,R30
	EOR	R13,R31		;В R13,R12 накапливается контрольная сумма 
	RJMP	RS_ks1
RS_ks2:	OUT	SREG,R10		;Восстановить состояние регистра статуса
	RETI

;***************************************************************************************
;	 USART передача завершена
;***************************************************************************************

RS_fin:	WDR			;Сброс сторожевого таймера
	IN	R10,SREG		;Сохранить состояние регистра статуса

;***************************************************************************************
;	Настроить USART на приём данных
;***************************************************************************************

Recept:	CLR	R12		;Инициализация USART	
	OUT	GPIOR0,R12		;Сбросить флаг - USART занят передачей данных
	CLR	R11		;Счётчик принятых байт по каналу USART
	STS	UBRR0H,R12		;Скорость 9600 при 4 мгц
	LDI	R20,$19		;8 - бит данных, два стоп бита
	STS	UBRR0L,R20
	LDI	R21,$40
	STS	UCSR0A,R21
	LDI	R20,$8E
	STS	UCSR0C,R20
	LDI	R21,$90
	STS	UCSR0B,R21		;Разрешить приём данных по USART и прерывания от USART
	COM	R12
	MOV	R13,R12		;Буфер контрольной суммы приема/передачи по USART
	OUT	SREG,R10		;Восстановить состояние регистра статуса
	RETI

;***************************************************************************************
;	Обработка прерываний по совпадению от таймера Т2 (50 mc.)
;***************************************************************************************

Comp2A:	WDR			;Сброс сторожевого таймера
	IN	R10,SREG		;Сохранить состояние регистра статуса
	TST	R2
	BREQ	Comp2A_1
	DEC	R2		;Вычесть 50 мс из времени блокировки ракетки N1	 
Comp2A_1:	TST	R3
	BREQ	Comp2A_2
	DEC	R3		;Вычесть 50 мс из времени блокировки ракетки N2
Comp2A_2:	INC	R9		;Прибавить к счётчику расширителю таймера Т2 50 мс.
	CP	R9,R4		;Счётчик блокировки поля А 
	BRCS	Comp2A_4
	IN	R29,EIMSK
	CPI	R29,$01		;Прерывания от поля А разрешены ?
	BREQ	Comp2A_3
	LDI	R29,$01
	OUT	EIMSK,R29		;Разрешить прерывания от INT0 
	OUT	EIFR,R29		;Сброс запросов на прерывание от INT0
Comp2A_3:	CLR	R4		;Сбросить счётчик блокировки поля А
Comp2A_4:	CP	R9,R5		;Счётчик блокировки поля Б 
	BRCS	Comp2A_6
	LDS	R29,PCICR
	CPI	R29,$07		;Прерывания от поля Б разрешены ?
	BREQ	Comp2A_5
	LDI	R29,$07
	STS	PCICR,R29		;Разрешить прерывания от PCINT3,PCINT11, PCINT23
	OUT	PCIFR,R29		;Сброс запросов на прерывание от PCINT3,PCINT11, PCINT23
Comp2A_5:	CLR	R5		;Сбросить счётчик блокировки поля Б
Comp2A_6:	LDS	R29,Interval	;Время паузы между сигналами от датчиков или ракеток (N*50 мс) 
	CP	R9,R29
	BRCS	Comp2A_7
	OUT	EIMSK,R8		;Запретить прерывания от INT0 
	STS	PCICR,R8		;Запретить прерывания от PCINT3,PCINT11, PCINT23
	RJMP	Start_5
Comp2A_7:	OUT	SREG,R10		;Восстановить состояние регистра статуса
	RETI

;***************************************************************************************
	 
.DSEG
.ORG $100
	; Переменные в ОЗУ

Buf_in:	.BYTE 10	;Буфер принимаемых данных по каналу USART
Buf_out:	.BYTE 8	;Буфер передаваемых данных по каналу USART

F_usart_R2:	.BYTE 1	;Флаг в Data_outR2 есть данные для передачи по USART ($55)
Data_outR2:	.BYTE 3	;Буфер данных для передачи по USART при ударе ракеткой N2 
F_usart_A:	.BYTE 1	;Флаг в Data_outA есть данные для передачи по USART ($55)
Data_outA:	.BYTE 3	;Буфер данных для передачи по USART при ударе от полю А 
F_usart_R1:	.BYTE 1	;Флаг в Data_outR1 есть данные для передачи по USART ($55)
Data_outR1:	.BYTE 3	;Буфер данных для передачи по USART при ударе ракеткой N1 
F_usart_B:	.BYTE 1	;Флаг в Data_outB есть данные для передачи по USART ($55)
Data_outB:	.BYTE 3	;Буфер данных для передачи по USART при ударе от полю Б

Stage_R2:	.BYTE 2	;Значение счётных регистров таймера Т1 при ударе ракеткой N2 
Stage_A:	.BYTE 2	;Значение счётных регистров таймера Т1 при ударе от полю А  
Stage_R1:	.BYTE 2	;Значение счётных регистров таймера Т1 при ударе ракеткой N1 
Stage_B:	.BYTE 2	;Значение счётных регистров таймера Т1 при ударе от полю Б

Stage_m:	.BYTE 2	;Темп игры минимальный
Stage_t:	.BYTE 2	;Темп игры "средний"
Chatter:	.BYTE 1	;Время задержки для подавления "дребезга" датчиков (N*50 мс) 
Interval:	.BYTE 1	;Время паузы между сигналами от датчиков или ракеток (N*50 мс) 

Code:	.BYTE 1	;Тип игры - $55,$AA,$99,$66,$33

Flag_N2:	.BYTE 1	;Флаг указатель был удар ракеткой N2 - $22,$A2,$62,$00
Flag_A:	.BYTE 1	;Флаг указатель был удар по полю А - $30,$B0,$00
Flag_N1:	.BYTE 1	;Флаг указатель был удар ракеткой N1 - $21,$A1,$61,$00
Flag_B:	.BYTE 1	;Флаг указатель был удар по полю Б - $31...39,$B1...$B9,$00

Flag_R:	.BYTE 1	;Буфер состояния ракетоки N2 

;***************************************************************************************
