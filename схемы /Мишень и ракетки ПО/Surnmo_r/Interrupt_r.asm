
;***************************************************************************************
;	Внешнее прерывание INT3 по спаду (поле А - датчик 0)
;***************************************************************************************

INT0:	WDR			;Сброс сторожевого таймера
	IN	R10,SREG		;Сохранить состояние регистра статуса
	LDS	R16,TCNT1L
	LDS	R17,TCNT1H		;Регистр данных таймера/счётчика Т1
	LDI	R19,$30		;Был удар по полю А
	CPI	R28,$33
	BRNE	INT0_1		;Тест датчиков и ракеток ?
	LDS	R7,Interval		;Время паузы между сигналами от датчиков или ракеток (N*50 мс) 
	LDS	R6,Chatter		;Блокировка прерываний от поля А на 500...2000 мс 
	MOV	R4,R6		;Блокировка поля A на 500...2000 мс 
	RJMP	Field_A7
INT0_1:	STS	Stage_A,R16
	STS	Stage_A+1,R17	;Значение таймера Т1 при ударе от полю А 
	CPI	R28,$55
	BREQ	Class_A5		;Игра c парнтёром активными ракетками ?

;***************************************************************************************
;	Игра c роботом активной ракеткой
;	Игра c партнёром пасивными ракетками
;	Игра c роботом роботом пасивной ракеткой
;***************************************************************************************

Class_A1:	LDS	R4,Chatter		;Установить счётчик блокировки поля А на 500...2000 мс 
	CPI	R28,$99		;Игра c партнёром пасивными ракетками ?
	BREQ	Class_A2
	CPI	R28,$66
	BREQ	Class_A2		;Игра c роботом пассивной ракеткой ?

	MOV	R18,R5
	CPI	R18,$02		;Игра c роботом активной ракеткой
	BRCS	Class_A3

	MOV	R5,R28		;Блокировка поля Б на 8,5 сек.
	RJMP	Class_A3	
Class_A2:	CLR	R5
	INC	R5		;Установить счётчик блокировки поля Б на 50 мс
Class_A3:	LDS	R18,Flag_B		;Флаг указатель был удар по полю Б -
				; $31...39,$B1...$B9,$71...$79,$00
	STS	Flag_B,R19		;Установить флаг данные прочитаны
	ANDI	R18,$3F		;Сбросить флаги
	BREQ	Field_A3		;Был превышен таймаут ? 
	CPI	R18,$31
	BRCS	Field_A0		;Нарушение последовательности сигналов ?
	CPI	R18,$3A
	BRCS	Class_A4		;Нарушение последовательности сигналов ?
	RJMP	Field_A0
Class_A4:	LDS	R6,Stage_B
	LDS	R7,Stage_B+1	;Значение таймера Т1 при ударе от полю Б 
	RJMP	Field_A5		;До этого был удар был по полю Б

;***************************************************************************************
;	Игра c парнтёром активными ракетками 
;***************************************************************************************

Class_A5:	MOV	R4,R28		;Установить счётчик блокировки поля A на 4,25 сек. 
	LDS	R18,Flag_N2		;Флаг указатель был удар ракеткой N2-$22,$A2,$62,$00
	STS	Flag_N2,R19		;Установить флаг данные прочитаны
	ANDI	R18,$3F		;Сбросить флаги
	BREQ	Field_A2		;Был превышен таймаут ? 
	CPI	R18,$22		;До этого был удар ракеткой N2 ?
	BREQ	Field_A4		;Нарушение последовательности сигналов ?
	; Нарушение последовательности сигналов до удара по полю А (0 датчик)
Field_A0:	ORI	R19,$80		;Взвести флаг нарушения последовательности
Field_A1:	LDS	R6,Stage_t
	LDS	R7,Stage_t+1	;Темп игры "средний"
	RJMP	Field_A7
	; Пауза в игре 
Field_A2:	LDS	R18,Flag_B		;Флаг указатель был удар по полю Б -
				;	$31...39,$B1...$B9,$71...$79,$00
	TST	R18
	BREQ	Field_A3
	LDS	R6,Stage_B
	LDS	R7,Stage_B+1	;Значение таймера Т1 при ударе от полю Б 
	RJMP	Field_A5
Field_A3:	ORI	R19,$40		;Взвести флаг паузы в игре 
	RJMP	Field_A1		
	; Формирование сообщеня о ударе по полю А
Field_A4:	LDS	R6,Stage_R2
	LDS	R7,Stage_R2+1	;Значение таймера Т1 при ударе ракеткой N2
Field_A5:	SUB	R16,R6
	SBC	R17,R7
	BRCC	Field_A6		;Коректировать результат ?
	SUBI	R16,$DC
	SBCI	R17,$0B

;***************************************************************************************
	; Преобразование разницы во времени в милисекунды. ((R7,R6) * 0,256.)
;***************************************************************************************

Field_A6:	LDI	R29,$89
	LDI	R18,$41		; R18,R29 = 0,256*65536
	; Умножение целых без знаковых чисел формата 16 на 16 бит.
	;     (R17,R16) множимое - (R18,R29) множитель
	MUL	R17,R18		; ah * bh
	MOVW	R7:R6,R1:R0
	MUL	R16,R29		; al * bl
	MOV	R2,R1
	MUL	R17,R29		; ah * bl
	ADD	R2,R0
	ADC	R6,R1
	ADC	R7,R8
	MUL	R16,R18		; al * bh
	ADD	R2,R0
	ADC	R6,R1
	ADC	R7,R8		;Результат в (R7,R6)
Field_A7:	CLR	R2		;Сбросить счётчик блокировки ракетки N1 
	STS	Flag_A,R19		;Флаг указатель был удар по полю А - $30,$B0,$70
	STS	Data_outA,R19	;Буфер данных для передачи по USART при ударе от полю А  
	STS	Data_outA+1,R7	;Время между последними ударами в милисекундах
	STS	Data_outA+2,R6	; записать в буфер данных передаваемых по USART
	STS	F_usart_A,R19	;Флаг в Data_outA есть данные для передачи по USART ($55)
	; Пуск со сбросом таймер Т2 и cброс запросов на прерывание от INT0,PCINT3,PCINT11,PCINT23,таймера Т2	
	CLR	R9		;Сброс счётчика расширителя таймера Т2
	LDI	R16,$02
	OUT	GTCCR,R16		;Сброс предделителя таймера Т2
	OUT	EIMSK,R9		;Запретить прерывания от INT0 
	STS	PCICR,R9		;Запретить прерывания от PCINT3,PCINT11, PCINT23
	STS	TCNT2,R9		;Сброс регистра данных таймера Т2
	STS	TIMSK2,R16		;Разрешить прерывания по совпадению А таймера Т2 
	LDI	R17,$07
	STS	TCCR2B,R17		;Пуск таймера/счётчика Т2
	OUT	TIFR2,R17		;Сброс запросов на прерывание от таймера Т2
	OUT	SREG,R10		;Восстановить состояние регистра статуса
	RETI

;***************************************************************************************
;	Внешнее прерывание PCINT3 по изменению состояния входов (поле Б - датчики 1,6,7)
;***************************************************************************************

PCI0:	WDR			;Сброс сторожевого таймера
	IN	R10,SREG		;Сохранить состояние регистра статуса
	IN	R18,PINB
	SBRC	R18,3
	RJMP	PCI0_1		;Если прерывание было по фронту на выводе B3
	; Определение сработавшего датчика 
	ANDI	R18,$07
	LDI	R19,$31		;R19 - датчик на игровом поле Б - 1
	CPI	R18,$06
	BREQ	PCI2_1
	LDI	R19,$37		;R19 - датчик на игровом поле Б - 7
	CPI	R18,$03
	BREQ	PCI2_1
	LDI	R19,$36		;R19 - датчик на игровом поле Б - 6
	RJMP	PCI2_1
	; Прерывание от 1...9 датчиков произошло по фронту 
PCI0_1:	CLR	R9		;Сброс счётчика расширителя таймера Т2
	INC	R5		; + 50 мс к времени блокировки поля Б
	LDI	R17,$02
	OUT	GTCCR,R17		;Сброс предделителя таймера Т2
	STS	TCNT2,R9		;Сброс регистра данных таймера Т2
	STS	TIMSK2,R17		;Разрешить прерывания по совпадению А таймера Т2 
	STS	PCICR,R9		;Запретить прерывания от PCINT3,PCINT11, PCINT23
	LDI	R16,$07
	STS	TCCR2B,R16		;Пуск таймера/счётчика Т2
	OUT	TIFR2,R16		;Сброс запросов на прерывание от таймера Т2
	OUT	SREG,R10		;Восстановить состояние регистра статуса
	RETI

;***************************************************************************************
;	Внешнее прерывание PCINT11 по изменению состояния входов (поле Б - датчики 2,5,8) 
;***************************************************************************************

PCI1:	WDR			;Сброс сторожевого таймера
	IN	R10,SREG		;Сохранить состояние регистра статуса
	IN	R18,PINC
	SBRC	R18,3
	RJMP	PCI0_1		;Если прерывание было по фронту на выводе C3
	; Определение сработавшего датчика 
	ANDI	R18,$07
	LDI	R19,$32		;R19 - датчик на игровом поле Б - 2
	CPI	R18,$06
	BREQ	PCI2_1
	LDI	R19,$38		;R19 - датчик на игровом поле Б - 8
	CPI	R18,$03
	BREQ	PCI2_1
	LDI	R19,$35		;R19 - датчик на игровом поле Б - 5
	RJMP	PCI2_1

;***************************************************************************************
;	Внешнее прерывание PCINT3 по изменению состояния входов (поле Б - датчики 3,4,9) 
;***************************************************************************************

PCI2:	WDR			;Сброс сторожевого таймера
	IN	R10,SREG		;Сохранить состояние регистра статуса
	IN	R18,PIND
	SBRC	R18,7
	RJMP	PCI0_1		;Если прерывание было по фронту на выводе D7
	; Определение сработавшего датчика
	ANDI	R18,$70
	LDI	R19,$33		;R19 - датчик на игровом поле Б - 3
	CPI	R18,$60
	BREQ	PCI2_1
	LDI	R19,$39		;R19 - датчик на игровом поле Б - 9
	CPI	R18,$30
	BREQ	PCI2_1
	LDI	R19,$34		;R19 - датчик на игровом поле Б - 4
	; Обработка удара по полю Б
PCI2_1:	LDS	R16,TCNT1L
	LDS	R17,TCNT1H		;Регистр данных таймера/счётчика Т1
	CPI	R28,$33
	BRNE	PCI2_2		;Тест датчиков и ракеток ?
	LDS	R7,Interval		;Время паузы между сигналами от датчиков или ракеток (N*50 мс) 
	LDS	R6,Chatter		;Блокировка прерываний от поля А на 500...2000 мс 
	MOV	R5,R6		;Блокировка поля Б на 500...2000 мс 
	RJMP	Field_B7
PCI2_2:	MOV	R5,R28		;Установить счётчик блокировки поля Б на 4,25...8,5 сек. 
	STS	Stage_B,R16
	STS	Stage_B+1,R17	;Значение таймера Т1 при ударе от полю Б 
	CPI	R28,$55
	BREQ	Class_B5		;Игра c парнтёром активными ракетками ?

;***************************************************************************************
;	Игра c партнёром пасивными ракетками
;	Игра c роботом пасивной ракеткой
;	Игра c роботом активной ракеткой
;***************************************************************************************

Class_B1:	CPI	R28,$99		;Игра c партнёром пасивными ракетками ?
	BREQ	Class_B3
	SBIC	PIND,2
	RJMP	Class_B2		;Сработал "0" датчик ?
	TST	R4
	BREQ	Class_B2		;Время анитидребезга истекло ?
	RJMP	PCI0_1
Class_B2:	CPI	R28,$66		;Игра c роботом пассивной ракеткой ?
	BREQ	Class_B4
	RJMP	Class_B5		;Игра c роботом активной ракеткой
Class_B3:	LDS	R5,Chatter		;Установить счётчик блокировки поля Б на 500...2000 мс 
Class_B4:	CLR	R4
	INC	R4		;Установить счётчик блокировки поля A на 50 мс
	LDS	R18,Flag_A		;Флаг указатель был удар по полю А-$30,$B0,$70,$00
	STS	Flag_A,R19		;Установить флаг данные прочитаны
	ANDI	R18,$3F		;Сбросить флаги
	BREQ	Field_B3		;Был превышен таймаут ? 
	CPI	R18,$30		;До этого был удар по полю А?
	BRNE	Field_B0		;Формирование сообщеня о ударе по полю Б ?
	LDS	R6,Stage_A
	LDS	R7,Stage_A+1	;Значение таймера Т1 при ударе от полю А 
	RJMP	Field_B5		;Нарушение последовательности сигналов

;***************************************************************************************
;	Игра c парнтёром активными ракетками (поле Б - датчики 1...9)
;***************************************************************************************

Class_B5:	CLR	R4
	INC	R4		;Установить счётчик блокировки поля A на 50 мс
	LDS	R18,Flag_N1		;Флаг указатель был удар ракеткой N1-$21,$61,$A1,$00
	STS	Flag_N1,R19		;Установить флаг данные прочитаны
	ANDI	R18,$3F		;Сбросить флаги
	BREQ	Field_B2		;Был превышен таймаут ? 
	CPI	R18,$21		;До этого был удар ракеткой N1 ?
	BREQ	Field_B4		;Нарушение последовательности сигналов ?
	; Нарушение последовательности сигналов до удара по полю Б
Field_B0:	ORI	R19,$80		;Взвести флаг нарушения последовательности
Field_B1:	LDS	R6,Stage_t
	LDS	R7,Stage_t+1	;Темп игры "средний"
	RJMP	Field_B7
	; Пауза в игре 
Field_B2:	LDS	R18,Flag_A		;Флаг указатель был удар по полю А-$30,$B0,$70,$00
	TST	R18
	BREQ	Field_B3
	LDS	R6,Stage_A
	LDS	R7,Stage_A+1	;Значение таймера Т1 при ударе от полю А 
	RJMP	Field_B5
Field_B3:	ORI	R19,$40		;Взвести флаг паузы в игре 
	RJMP	Field_B1			
	; Формирование сообщеня о ударе по полю Б
Field_B4:	LDS	R6,Stage_R1
	LDS	R7,Stage_R1+1	;Значение таймера Т1 при ударе ракеткой N1
Field_B5:	SUB	R16,R6
	SBC	R17,R7
	BRCC	Field_B6		;Коректировать результат ?
	SUBI	R16,$DC
	SBCI	R17,$0B

;***************************************************************************************
	; Преобразование разницы во времени в милисекунды. ((R7,R6) * 0,256.)
;***************************************************************************************

Field_B6:	LDI	R29,$89
	LDI	R18,$41		; R18,R29 = 0,256*65536
	; Умножение целых без знаковых чисел формата 16 на 16 бит.
	;     (R17,R16) множимое - (R18,R29) множитель
	MUL	R17,R18		; ah * bh
	MOVW	R7:R6,R1:R0
	MUL	R16,R29		; al * bl
	MOV	R3,R1
	MUL	R17,R29		; ah * bl
	ADD	R3,R0
	ADC	R6,R1
	ADC	R7,R8
	MUL	R16,R18		; al * bh
	ADD	R3,R0
	ADC	R6,R1
	ADC	R7,R8		;Результат в (R7,R6)
Field_B7:	CLR	R3		;Сбросить счётчик блокировки ракетки N2 
	STS	Flag_B,R19		;Флаг указатель был удар по полю Б -
				;	$31...39,$B1...$B9,$71...$79
	STS	Data_outB,R19	;Буфер данных для передачи по USART при ударе от полю Б
	STS	Data_outB+1,R7	;Время между последними ударами в милисекундах
	STS	Data_outB+2,R6	; записать в буфер данных передаваемых по USART
	STS	F_usart_B,R19	;Флаг в Data_outB есть данные для передачи по USART ($55)

	; Пуск со сбросом таймер Т2 и cброс запросов на прерывание от INT0,PCINT3,PCINT11,PCINT23,таймера Т2	
	CLR	R9		;Сброс счётчика расширителя таймера Т2
	LDI	R16,$02
	OUT	GTCCR,R16		;Сброс предделителя таймера Т2
	OUT	EIMSK,R9		;Запретить прерывания от INT0 
	STS	PCICR,R9		;Запретить прерывания от PCINT3,PCINT11, PCINT23
	STS	TCNT2,R9		;Сброс регистра данных таймера Т2
	STS	TIMSK2,R16		;Разрешить прерывания по совпадению А таймера Т2 
	LDI	R17,$07
	STS	TCCR2B,R17		;Пуск таймера/счётчика Т2
	OUT	TIFR2,R17		;Сброс запросов на прерывание от таймера Т2
	OUT	SREG,R10		;Восстановить состояние регистра статуса
	RETI

;***************************************************************************************

