.Device ATmega48		;С кварцем на 4,0 Мгц

.equ	UDR0	= 0xc6	;USART0 регистр Данных Ввода - вывода
.equ	UBRR0H	= 0xc5	;USART0 ст. байт регистра скорости
.equ	UBRR0L	= 0xc4	;USART0 мл. байт регистра скорости
.equ	UCSR0C	= 0xc2	;USART0 регистр управления и состояния C 
.equ	UCSR0B	= 0xc1	;USART0 регистр управления и состояния B 
.equ	UCSR0A	= 0xc0	;USART0 регистр управления и состояния A 
.equ	TWAMR	= 0xbd	;TWI регистр маски адреса
.equ	TWCR	= 0xbc	;TWI регистр управления
.equ	TWDR	= 0xbb	;TWI регистр данных
.equ	TWAR	= 0xba	;TWI регистр адреса
.equ	TWSR	= 0xb9	;TWI регистр состояния;
.equ	TWBR	= 0xb8	;TWI регистр скорости передачи
.equ	ASSR	= 0xb6	;Регистр асинхронного режима
.equ	OCR2B	= 0xb4	;Регистра совпадения B таймера/счётчика Т2
.equ	OCR2A	= 0xb3	;Регистра совпадения A таймера/счётчика Т2
.equ	TCNT2	= 0xb2	;Счётный регистр таймера/счётчика Т2
.equ	TCCR2B	= 0xb1	;Регистр управления B таймера/счётчика Т2
.equ	TCCR2A	= 0xb0	;Регистр управления A таймера/счётчика Т2
.equ	OCR1BH	= 0x8b	;Регистр совпадения В таймера/счётчика Т1 ст. байт
.equ	OCR1BL	= 0x8a	;Регистр совпадения В таймера/счётчика Т1 мл. байт
.equ	OCR1AH	= 0x89	;Регистр совпадения А таймера/счётчика Т1 ст. байт
.equ	OCR1AL	= 0x88	;Регистр совпадения А таймера/счётчика Т1 мл. байт
.equ	ICR1H	= 0x87	;Регистр захвата таймера/счётчика Т1 ст. байт
.equ	ICR1L	= 0x86	;Регистр захвата таймера/счётчика Т1 мл. байт
.equ	TCNT1H	= 0x85	;Регистр данных таймера/счётчика Т1 ст. байт
.equ	TCNT1L	= 0x84	;Регистр данных таймера/счётчика Т1 мл. байт
.equ	TCCR1C	= 0x82	;Регистр управления C таймера/счётчика Т1
.equ	TCCR1B	= 0x81	;Регистр управления B таймера/счётчика Т1
.equ	TCCR1A	= 0x80	;Регистр управления A таймера/счётчика Т1
.equ	DIDR1	= 0x7f	;Регистр 1 отключения цифровых входов
.equ	DIDR0	= 0x7e	;Регистр 0 отключения цифровых входов
.equ	ADMUX	= 0x7c	;Регистр управления мультиплексором АЦП
.equ	ADCSRB	= 0x7b	;Регистр B управления и состояния АЦП
.equ	ADCSRA	= 0x7a	;Регистр A управления и состояния АЦП
.equ	ADCH	= 0x79	;Ст. байт регистра данных АЦП
.equ	ADCL	= 0x78	;Мл. байт регистра данных АЦП
.equ	TIMSK2	= 0x70	;Регистр маски прерываний от таймера/счётчика T2
.equ	TIMSK1	= 0x6f	;Регистр маски прерываний от таймера/счётчика T1
.equ	TIMSK0	= 0x6e	;Регистр маски прерываний от таймера/счётчика T0
.equ	PCMSK2	= 0x6d	;Регистр маски 2-го прерывания по изменению состояний выводов
.equ	PCMSK1	= 0x6c	;Регистр маски 1-го прерывания по изменению состояний выводов
.equ	PCMSK0	= 0x6b	;Регистр маски 0-го прерывания по изменению состояний выводов
.equ	EICRA	= 0x69	;Регистр А управления внешними прерываниями
.equ	PCICR	= 0x68	;Регистр управления прерываниями по изменению состояний выводов
.equ	OSCCAL	= 0x66	;Регистр калибровки внутреннего генератора
.equ	PRR	= 0x64	;Регистр снижения потребляемой мощности
.equ	CLKPR	= 0x61	;Регистр предделителя тактового сигнала
.equ	WDTCSR	= 0x60	;Регистр управления и состаяния сторожевого таймера
.equ	SREG	= 0x3f	;Регистр состояния
.equ	SPH	= 0x3e	;Младший байт регистра указателя стека
.equ	SPL	= 0x3d	;Старший байт регистра указателя стека
.equ	SPMCSR	= 0x37	;Регистр управления и состояния операций записи в памать программ
.equ	MCUCR	= 0x35	;Регистр управления микроконтроллера
.equ	MCUSR	= 0x34	;Регистр состаяния микроконтроллера
.equ	SMCR	= 0x33	;Регистр для управления *спящим* режимом
.equ	ACSR	= 0x30	;Регистр управления и состояния аналоговым компаратором
.equ	SPDR	= 0x2e	;SPI регистр Данных
.equ	SPSR	= 0x2d	;SPI регистр состояния
.equ	SPCR	= 0x2c	;SPI регистр управления
.equ	GPIOR2	= 0x2b	;2-й регистр ввода/вывода общего назначения
.equ	GPIOR1	= 0x2a	;1-й регистр ввода/вывода общего назначения
.equ	OCR0B	= 0x28	;Регистра совпадения B таймера/счётчика Т0
.equ	OCR0A	= 0x27	;Регистра совпадения A таймера/счётчика Т0
.equ	TCNT0	= 0x26	;Счётный регистр таймера/счётчика Т0
.equ	TCCR0B	= 0x25	;Регистр управления B таймера/счётчика Т0
.equ	TCCR0A	= 0x24	;Регистр управления A таймера/счётчика Т0
.equ	GTCCR	= 0x23	;Общий регистр управления таймеров/счётчиков
.equ	EEARH	= 0x22	;Регистр адреса EEPROM ст. байт
.equ	EEARL	= 0x21	;Регистр адреса EEPROM мл. байт
.equ	EEDR	= 0x20	;Регистр данных EEPROM
.equ	EECR	= 0x1f	;Регистр управления EEPROM
.equ	GPIOR0	= 0x1e	;0-й регистр ввода/вывода общего назначения
.equ	EIMSK	= 0x1d	;Регистр маски внешних прерываний
.equ	EIFR	= 0x1c	;Регистр флагов прерываний
.equ	PCIFR	= 0x1b	;Регистр флагов прерываний по изменению состояний выводов
.equ	TIFR2	= 0x17	;Регистр флагов прерывания таймера/счётчика T2
.equ	TIFR1	= 0x16	;Регистр флагов прерывания таймера/счётчика T1
.equ	TIFR0	= 0x15	;Регистр флагов прерывания таймера/счётчика T0
.equ	PORTD	= 0x0b	;Регистр данных порт D (выход)
.equ	DDRD	= 0x0a	;Регистр направления порт D
.equ	PIND	= 0x09	;Выводы порт D (вход)
.equ	PORTC	= 0x08	;Регистр данных порт C (выход)
.equ	DDRC	= 0x07	;Регистр направления порт C
.equ	PINC	= 0x06	;Выводы порт C (вход)
.equ	PORTB	= 0x05	;Регистр данных порт B (выход)
.equ	DDRB	= 0x04	;Регистр направления порт B
.equ	PINB	= 0x03	;Выводы порт B (вход)
.equ 	RAMEND	= 0x2FF	;Верхняя граница области ОЗУ

.CSEG
.ORG $000

Start:	RJMP	Start_1		;Обработка сброса
	RJMP	INT0		;Внешнее прерывание 0
	RETI			;Внешнее прерывание 1
	RJMP	PCI0		;Прерывание 0 по изменению сост. выводов
	RJMP	PCI1		;Прерывание 1 по изменению сост. выводов
	RJMP	PCI2		;Прерывание 2 по изменению сост. выводов
	RJMP	Start_4		;Тайм-аут сторожевого таймера
	RJMP	Comp2A		;Совпадение А таймера/счётчика Т2
	RETI			;Совпадение В таймера/счётчика Т2
	RETI			;Переполнение таймера/счётчика Т2
	RETI			;Захват таймера/счётчика T1
	RETI			;Совпадение А таймера/счётчика Т1
	RETI			;Совпадение В таймера/счётчика Т1
	RETI			;Переполнение таймера/счётчика Т1
	RETI			;Совпадение А таймера/счётчика Т0
	RETI			;Совпадение В таймера/счётчика Т0
	RETI			;Переполнение таймера/счётчика Т0
	RETI			;Передача по SPI завершена
	RJMP	RS_in		;USART приём завершен
	RJMP	RS_out		;Регистр данных USART пуст
	RJMP	RS_fin		;USART передача завершена
	RETI			;Преобразование АЦП завершено
	RETI			;EEPROM готово
	RETI			;Аналоговый компаратор	
	RETI			;Прерывание от модуля TWI
	RETI			;Готовность SPM

;***************************************************************************************

	; Конфигурирование портов
Start_1:	CLI			;Запретить глобальные прерывания
	CLR	R8
	LDI	R16,$10
	LDI	R17,$FF
	LDI	R18,$EF
	OUT	DDRB,R16		;Вывод B4 порта вкл./выкл. приёмник nrF2401
	OUT	DDRC,R8
	OUT	DDRD,R8
	OUT	PORTB,R18
	OUT	PORTC,R17
	OUT	PORTD,R17
	; Инициализация внешних прерываний
	LDI	R17,$02
	LDI	R18,$80
	LDI	R19,$08
	STS	EICRA,R17		;Прерывание отINT0 по спаду
	STS	PCMSK2,R18		;Прерывание от PD7 по изменению состояний вывода
	STS	PCMSK1,R19		;Прерывание от PC3 по изменению состояний вывода
	STS	PCMSK0,R19		;Прерывание от PB3 по изменению состояний вывода
	LDI	R20,$85		;Отключить модули TWI,SPI,АЦП
	STS	PRR,R20		;Регистр снижения потребляемой мощности
	; Очистка ОЗУ после включения питания.
	IN	R16,MCUSR
	OUT	MCUSR,R8
	ANDI	R16,$01		;Было включение питания ?
	BREQ	Start_3
	LDI	R28,LOW(Buf_in)
	LDI	R29,HIGH(Buf_in)	;Начало области ОЗУ
Start_2:	ST	Y+,R8
	CPI	R29,$03
	BRCS	Start_2
	LDI	R22,$0B
	STS	Chatter,R22		;Время антидребезга 0,55 сек. (N*50 мс) 
	LDI	R25,$23
	STS	Interval,R25	;Время паузы между сигналами 1,75 сек. (N*50 мс) 
	LDI	R26,$EE
	LDI	R27,$02
	STS	Stage_m,R26
	STS	Stage_m+1,R27	;Темп игры минимальный 0,75 сек.
	LDI	R24,$D1
	LDI	R25,$01
	STS	Stage_t,R24
	STS	Stage_t+1,R25	;Темп игры средний 0,465 сек.
	; Пуск сторожевого таймера с периодом срабатывания 8 сек.
Start_3:	WDR			;Сброс сторожевого таймера
	LDI	R28,$18
	LDI	R29,$69
	STS	WDTCSR,R28
	STS	WDTCSR,R29
	; Инициализация таймера Т1 
Start_4:	LDI	R22,$23
	LDI	R23,$F4
 	STS	TCCR1A,R8		;Настройка таймера Т1 с периодом вызова
 	STS	TCCR1C,R8		; прерываний по совпадению A 16,0 сек 
	STS	OCR1AH,R23		;Регистр совпадения А таймера/счётчика Т1 ст. байт
	STS	OCR1AL,R22		;Регистр совпадения А таймера/счётчика Т1 мл. байт
	LDI	R24,$0D
 	STS	TCCR1B,R24		;Пуск таймера/счётчика Т1
Start_5:	CLR	R9		;Сброс счётчика расширителя таймера Т2
	STS	Flag_N2,R9		;Сбросить был удар ракеткой N2
	STS	Flag_A,R9		;Сбросить был удар по полю А
	STS	Flag_N1,R9		;Сбросить был удар ракеткой N1
	STS	Flag_B,R9		;Сбросить был удар по полю Б
	; Инициализация таймера Т2 
	LDI	R22,$02
	LDI	R23,$C3
	STS	TCCR2A,R22		;Настройка таймера Т2 с периодом вызова
	STS	OCR2A,R23		; прерываний по совпадению A 50,0 мс
	STS	TCCR2B,R9		;Стоп таймера/счётчика Т2
	CLR	R2		;Сбросить счётчик блокировки ракетки N1 
	CLR	R3		;Сбросить счётчик блокировки ракетки N2 
	MOVW	R5:R4,R3:R2		;Сбросить счётчики блокировки полей A и Б 
	LDI	R25,$01
	OUT	EIMSK,R25		;Разрешить прерывания от INT0 
	STS	PCICR,R9		;Запретить прерывания от PCINT3,PCINT11, PCINT23
	LDS	R28,Code		;R28 тип игры - $55,$AA,$99,$66,$33
	CPI	R28,$33
	BREQ	Start_6		;Тест датчиков и ракеток ?
	CPI	R28,$55
	BRNE	Start_7		;Игра c парнтёром активными ракетками ?

Start_6:	LDI	R26,$07
	STS	PCICR,R26		;Разрешить прерывания от PCINT3,PCINT11, PCINT23
	RJMP	Start_9

Start_7:	CPI	R28,$99		;Игра c партнёром пассивными ракетками ?
	BREQ	Start_8
	MOV	R5,R23		;Установить счётчик блокировки поля Б на 9,75 сек.
Start_8:	MOV	R2,R23		;Установить счётчик блокировки ракетки N1 на 9,75 сек.
	MOV	R3,R23		;Установить счётчик блокировки ракетки N2 на 9,75 сек.

Start_9:	SER	R27
	OUT	PCIFR,R27		;Сброс запросов на прерывание от PCINT3,PCINT11, PCINT23
	OUT	EIFR,R27		;Сброс запросов на прерывание от INT0
	OUT	TIFR2,R27		;Сброс запросов на прерывание от таймера Т2
	LDI	R24,LOW(RAMEND)
	LDI	R25,HIGH(RAMEND)	;Верхняя граница области ОЗУ
	OUT	SPL,R24
	OUT	SPH,R25		;Установка стека
	RCALL	Recept		;Настроить USART на приём данных

;Start_10:	RCALL	Field_B6		;Преобразовать в милисекунды 
;	RJMP	Start_10

;***************************************************************************************
	; Фоновая задача
;***************************************************************************************

Fon:	SEI			;Разрешить глобальные прерывания
	CLR	R8
	LDS	R28,Code		;R28 тип игры - $55,$AA,$99,$66,$33
	CPI	R28,$33
	BREQ	Fon_1		;Тест датчиков и ракеток ?
	CPI	R28,$55
	BREQ	Fon_1		;Игра c парнтёром активными ракетками ?
	CPI	R28,$AA
	BREQ	Fon_1		;Игра c роботом активной ракеткой ?
	SBI	PORTB,4		;Выключить приёмник nrF2401
	CPI	R28,$99
	BREQ	Fon_3		;Игра c партнёром пасивными ракетками ?
	CPI	R28,$66
	BREQ	Fon_3		;Игра c роботом пасивной ракеткой ?
	CLI			;Запретить глобальные прерывания
	LDI	R28,$66
	STS	Code,R28		;Сохранить тип игры (по умолчанию) - $66
	RJMP	Start_4
Fon_1:	CBI	PORTB,4		;Включить приёмник nrF2401
	CLI			;Запретить глобальные прерывания
	IN	R24,PINC
	ANDI	R24,$10		;Состояние ракетки N2
	OR	R24,R3
	STS	Flag_R,R24		;Буфер состояния ракетоки N2 
	IN	R23,PIND
	ANDI	R23,$08		;Состояние ракетки N1
	OR	R23,R2
	BRNE	Fon_2   
	RCALL	Racket_A		;Обработа удара ракеткой N1
Fon_2:	LDS	R24,Flag_R		;Буфер состояния ракетоки N2 
	TST	R24
	BRNE	Fon_3
	RCALL	Racket_B		;Обработа удара ракеткой N2		
	; Обработа приёма/передачи данных по каналу USART
Fon_3:	IN	R25,GPIOR0		;Флаг - USART занят передачей данных ($55)
	CPI	R25,$55
	BRNE	Usart_out
	RJMP	Fon

;***************************************************************************************
	; Передача данных по каналу USART
;***************************************************************************************

Usart_out:	LDS	R24,F_usart_A	;Флаг в Data_outA есть данные для передачи по USART
	TST	R24
	BREQ	Usart_out1
	STS	F_usart_A,R8	;Сбросить флаг - F_usart_A
	LDS	R22,Data_outA	;Буфер данных готовых для передачи по USART
	LDS	R23,Data_outA+1
	LDS	R24,Data_outA+2	;Время между последними ударми
	RJMP	Usart_out4
Usart_out1:	LDS	R24,F_usart_R1	;Флаг в Data_outR1 есть данные для передачи по USART
	TST	R24
	BREQ	Usart_out2
	STS	F_usart_R1,R8	;Сбросить флаг - F_usart_R1
	LDS	R22,Data_outR1	;Буфер данных готовых для передачи по USART
	LDS	R23,Data_outR1+1
	LDS	R24,Data_outR1+2	;Время между последними ударми
	RJMP	Usart_out4
Usart_out2:	LDS	R24,F_usart_R2	;Флаг в Data_outR2 есть данные для передачи по USART
	TST	R24
	BREQ	Usart_out3
	STS	F_usart_R2,R8	;Сбросить флаг - F_usart_R2
	LDS	R22,Data_outR2	;Буфер данных готовых для передачи по USART
	LDS	R23,Data_outR2+1
	LDS	R24,Data_outR2+2	;Время между последними ударми
	RJMP	Usart_out4
Usart_out3:	LDS	R24,F_usart_B	;Флаг в Data_outB есть данные для передачи по USART
	TST	R24
	BREQ	Usart_in
	STS	F_usart_B,R8	;Сбросить флаг - F_usart_B
	LDS	R22,Data_outB	;Буфер данных готовых для передачи по USART
	LDS	R23,Data_outB+1
	LDS	R24,Data_outB+2	;Время между последними ударми
Usart_out4:	LDS	R28,Code		;R28 тип игры - $55,$AA,$99,$66,$33
	STS	Buf_out,R28		;Код типа игры
	STS	Buf_out+2,R22	;Код точки удара (N ракетки, поле А,Б) и номер датчика
	STS	Buf_out+3,R23
	STS	Buf_out+4,R24	;Время между последними ударми
Usart_out5:	WDR			;Сброс сторожевого таймера
	LDI	R26,$03
	LDI	R27,$05
	STS	Buf_out+1,R26	;Количество байт данных
	OUT	GPIOR2,R27		;Общее количество передаваемых байт (без КС)

;***************************************************************************************
;	Настроить USART на передачу данных
;***************************************************************************************

	LDI	R30,LOW(Buf_out)
	LDI	R31,HIGH(Buf_out)	;Адрес данных в буфере передаваемых по USART
	MOVW	R15:R14,R31:R30	;Сохранить - Адрес данных передаваемых по USART
	LDI	R21,$55
	OUT	GPIOR0,R21		;Флаг - USART занят передачей данных ($55)
	CLI			;Запретить глобальные прерывания
	CLR	R12
	STS	UBRR0H,R12		;Скорость 9600 при 4 мгц
	LDI	R20,$19		;8 - бит данных, два стоп бита
	STS	UBRR0L,R20
	LDI	R21,$40
	STS	UCSR0A,R21
	LDI	R21,$8E
	STS	UCSR0C,R21
	LDI	R20,$28
	STS	UCSR0B,R20		;Разрешить передачу данных по USART и прерывания от USART
	COM	R12
	MOV	R13,R12		;Буфер контрольной суммы приема/передачи по USART
Return:	RJMP	Fon

;***************************************************************************************
	; Обработка принятых данных по каналу USART
;***************************************************************************************

Usart_in:	IN	R25,GPIOR1		;Флаг указатель - приняты данные по каналу USART ($55)
	CPI	R25,$55
	BRNE	Return
	CLI			;Запретить глобальные прерывания
	LDI	R22,$AA
	OUT	GPIOR1,R22		;Сбросить флаг - приняты данные по каналу USART ($AA)
	LDS	R22,Buf_in
	LDS	R23,Buf_in+2	;Буфер принимаемых данных по USART
	CPI	R22,$33
	BRNE	Usart_in1		;Ошибка передачи ?
	CPI	R23,$99
	BRNE	Return		;Повторить передачу ?
	RJMP	Usart_out5		;Передача данных по каналу USART
Usart_in1:	CPI	R22,$CC
	BRNE	Return		;Код режима работы ?
	STS	Code,R23		;Сохранить тип игры - $55,$AA,$99,$66,$33
	LDS	R6,Buf_in+3		;Время антидребезга (t/8) при ударе от полю А
	CLR	R7
	LDI	R16,$F5
	LDI	R17,$28
	; Умножение целых без знаковых чисел формата 16 на 16 бит.
	;     (R7,R6) множимое - (R17,R16) множитель
	MUL	R17,R7		; ah * bh
	MOVW	R25:R24,R1:R0
	MUL	R16,R6		; al * bl
	MOV	R9,R1
	MUL	R17,R6		; ah * bl
	ADD	R9,R0
	ADC	R24,R1
	ADC	R25,R8
	MUL	R16,R7		; al * bh
	ADD	R9,R0
	ADC	R24,R1
	ADC	R25,R8
	STS	Chatter,R24		;Время задержки для подаления "дребезга" датчиков  (N*50 мс) 
	LDS	R6,Buf_in+5		;Время паузы между сигналами (t/16)
	CLR	R7
	LDI	R16,$EB
	LDI	R17,$51

	; Умножение целых без знаковых чисел формата 16 на 16 бит.
	;     (R7,R6) множимое - (R17,R16) множитель
	MUL	R17,R7		; ah * bh
	MOVW	R25:R24,R1:R0
	MUL	R16,R6		; al * bl
	MOV	R9,R1
	MUL	R17,R6		; ah * bl
	ADD	R9,R0
	ADC	R24,R1
	ADC	R25,R8
	MUL	R16,R7		; al * bh
	ADD	R9,R0
	ADC	R24,R1
	ADC	R25,R8
	STS	Interval,R24	;Время паузы между сигналами от датчиков или ракеток (N*50 мс) 

	LDS	R6,Buf_in+4		;Темп игры (t/8)
	MOV	R8,R6
	CLR	R7
	LSL	R8
	ROL	R7
	LSL	R8
	ROL	R7
	LSL	R8
	ROL	R7
	STS	Stage_m,R8
	STS	Stage_m+1,R7	;Сохранить темп игры минимальный
	LDI	R16,$05
	MUL	R6,R16		;Темп игры средний =(t*0,62)
	STS	Stage_t,R0
	STS	Stage_t+1,R1	;Сохранить темп игры "средний"
	RJMP	Start_4

;***************************************************************************************
; Обработа удара ракеткой N1 - Игра c парнтёром активными ракетками
; Обработа удара ракеткой N1 - Игра c роботом активной ракеткой
;***************************************************************************************

Racket_A:	WDR			;Сброс сторожевого таймера
	LDS	R26,TCNT1L
	LDS	R27,TCNT1H		;Регистр данных таймера/счётчика Т1
	SUBI	R26,$19		;Вычесть 17 милисекунд (6,5/0,000256 мкс t отклика ракетки)
	SBCI	R27,$00
	BRCC	Rac_A_1		;Коректировать результат ?
	SUBI	R26,$DC
	SBCI	R27,$0B
Rac_A_1:	STS	Stage_R1,R26
	STS	Stage_R1+1,R27	;Значение таймера Т1 при ударе ракеткой N1
	LDI	R22,$21		;Был удар ракеткой N1
	CLR	R2
	INC	R2		;Установить счётчик блокировки ракетки N1 на 50 мс.
	CPI	R28,$33		;Тест датчиков и ракеток ?
	BREQ	Report_A_2
	INC	R4		; + 50 мс к времени блокировки поля А
	MOV	R2,R28		;Установить счётчик блокировки ракетки N1 на 4,25 сек.
	LDS	R23,Flag_A		;Флаг указатель был удар по полю А - $30,$B0,$70,$00
	STS	Flag_A,R22		;Установить флаг данные прочитаны
	ANDI	R23,$3F		;Сбросить флаги
	BREQ	Rac_A_3		;Был превышен таймаут ? 
	CPI	R23,$30		;До этого был удар по полю А ?
	BREQ	Report_A		;Нарушение последовательности сигналов ?
	; Нарушение последовательности сигналов до удара ракеткой N1
	ORI	R22,$80		;Взвести флаг нарушения последовательности
	RJMP	Report_A_2
	; Пауза в игре 
Rac_A_3:	ORI	R22,$40		;Взвести флаг паузы в игре 
	RJMP	Report_A_2
	; Формирование сообщеня о ударе ракеткой N1
Report_A:	LDS	R6,Stage_A
	LDS	R7,Stage_A+1	;Значение таймера Т1 при ударе по полю А
	SUB	R26,R6
	SBC	R27,R7
	BRCC	Report_A_1		;Коректировать результат ?
	SUBI	R26,$DC
	SBCI	R27,$0B

;***************************************************************************************
	; Преобразование разницы во времени в милисекунды. ((R7,R6) * 0,256.)
;***************************************************************************************

Report_A_1:	LDI	R24,$89
	LDI	R25,$41		; R25,R24 = 0,256*65536
	; Умножение целых без знаковых чисел формата 16 на 16 бит.
	;         (R27,R26) множимое - (R25,R24) множитель
	MUL	R27,R25		; ah * bh
	MOVW	R7:R6,R1:R0
	MUL	R26,R24		; al * bl
	MOV	R9,R1
	MUL	R27,R24		; ah * bl
	ADD	R9,R0
	ADC	R6,R1
	ADC	R7,R8
	MUL	R26,R25		; al * bh 
	ADD	R9,R0
	ADC	R6,R1
	ADC	R7,R8		;Результат в (R7,R6)
	LDS	R26,Stage_m
	LDS	R27,Stage_m+1	;Темп игры минимальный
	CP	R6,R26
	CPC	R7,R27
	BRCS	Report_A_3
Report_A_2:	LDS	R6,Stage_t
	LDS	R7,Stage_t+1	;Темп игры "средний"
Report_A_3:	STS	Flag_N1,R22		;Флаг указатель был удар ракеткой N1 - $21,$A1,$61
	STS	Data_outR1,R22	;Буфер данных для передачи по USART при ударе ракеткой N1 
	STS	Data_outR1+1,R7	;Время между последними ударами в милисекундах
	STS	Data_outR1+2,R6	; записать в буфер данных передаваемых по USART
	STS	F_usart_R1,R22	;Флаг в Data_outR1 есть данные для передачи по USART
	; Пуск со сбросом таймер Т2	
	CLR	R5
	STS	PCICR,R5		;Запретить прерывания от PCINT3,PCINT11, PCINT23
	INC	R5		;Установить счётчик блокировки поля Б на 20 мс. 
	RJMP	Report_C

;***************************************************************************************
; Обработа удара ракеткой N2 - Игра c парнтёром активными ракетками
;***************************************************************************************

Racket_B:	WDR			;Сброс сторожевого таймера
	LDS	R26,TCNT1L
	LDS	R27,TCNT1H		;Регистр данных таймера/счётчика Т1
	SUBI	R26,$19		;Вычесть 17 милисекунд (6,5/0,000256 мкс t отклика ракетки)
	SBCI	R27,$00
	BRCC	Rac_B_1		;Коректировать результат ?
	SUBI	R26,$DC
	SBCI	R27,$0B
Rac_B_1:	STS	Stage_R2,R26
	STS	Stage_R2+1,R27	;Значение таймера Т1 при ударе ракеткой N2
	LDI	R22,$22		;Был удар ракеткой N2
	CLR	R3
	INC	R3		;Установить счётчик блокировки ракетки N2 на 50 мс.
	CPI	R28,$33
	BREQ	Report_B_2		;Тест датчиков и ракеток ?
	CPI	R28,$55
	BREQ	Rac_B_2		;Игра c парнтёром активными ракетками ?
	RETI
Rac_B_2:	INC	R5		; + 50 мс к времени блокировки поля Б
	MOV	R3,R28		;Установить счётчик блокировки ракетки N2 на 4,25 сек.
	LDS	R23,Flag_B		;Флаг указатель был удар по полю Б - 
				;	$31...39,$B1...$B9,$71...$79,$00
	STS	Flag_A,R22		;Установить флаг данные прочитаны
	ANDI	R23,$3F		;Сбросить флаги
	BREQ	Rac_B_4		;Был превышен таймаут ? 
	CPI	R23,$31
	BRCS	Rac_B_3
	CPI	R23,$3A
	BRCS	Report_B		;Был удар по полю Б (1-9 дат.) ?
	; Нарушение последовательности сигналов до удара ракеткой N1, N2
Rac_B_3:	ORI	R22,$80		;Взвести флаг нарушения последовательности
	RJMP	Report_B_2
	; Пауза в игре 
Rac_B_4:	ORI	R22,$40		;Взвести флаг паузы в игре 
	RJMP	Report_B_2
	; Формирование сообщеня о ударе ракеткой N2	
Report_B:	LDS	R6,Stage_B
	LDS	R7,Stage_B+1	;Значение таймера Т1 при ударе от полю Б
	SUB	R26,R6
	SBC	R27,R7
	BRCC	Report_B_1		;Коректировать результат ?
	SUBI	R26,$DC
	SBCI	R27,$0B

;***************************************************************************************
	; Преобразование разницы во времени в милисекунды. ((R7,R6) * 0,256.)
;***************************************************************************************

Report_B_1:	LDI	R24,$89
	LDI	R25,$41		; R25,R24 = 0,256*65536
	; Умножение целых без знаковых чисел формата 16 на 16 бит.
	;         (R27,R26) множимое - (R25,R24) множитель
	MUL	R27,R25		; ah * bh
	MOVW	R7:R6,R1:R0
	MUL	R26,R24		; al * bl
	MOV	R9,R1
	MUL	R27,R24		; ah * bl
	ADD	R9,R0
	ADC	R6,R1
	ADC	R7,R8
	MUL	R26,R25		; al * bh 
	ADD	R9,R0
	ADC	R6,R1
	ADC	R7,R8		;Результат в (R7,R6)
	LDS	R26,Stage_m
	LDS	R27,Stage_m+1	;Темп игры минимальный
	CP	R6,R26
	CPC	R7,R27
	BRCS	Report_B_3
Report_B_2:	LDS	R6,Stage_t
	LDS	R7,Stage_t+1	;Темп игры "средний"
Report_B_3:	STS	Flag_N2,R22		;Флаг указатель был удар ракеткой N2 - $22,$A2,$62
	STS	Data_outR2,R22	;Буфер данных для передачи по USART при ударе ракеткой N1 
	STS	Data_outR2+1,R7	;Время между последними ударами в милисекундах
	STS	Data_outR2+2,R6	; записать в буфер данных передаваемых по USART
	STS	F_usart_R2,R22	;Флаг в Data_outR2 есть данные для передачи по USART
	; Пуск со сбросом таймер Т2	
	CLR	R4
	OUT	EIMSK,R4		;Запретить прерывания от INT0 
	INC	R4		;Установить счётчик блокировки поля A на 20 мс. 
Report_C:	LDI	R23,$02
	OUT	GTCCR,R23		;Сброс предделителя таймера Т2
	LDI	R24,$7F
	STS	TCNT2,R24		;Сброс регистра данных таймера Т2
	STS	TIMSK2,R23		;Разрешить прерывания по совпадению А таймера Т2 
	LDI	R25,$07
	STS	TCCR2B,R25		;Пуск таймера Т2
	SER	R26
	OUT	TIFR2,R26		;Сброс запросов на прерывание от таймера Т2
	OUT	EIFR,R26		;Сброс запросов на прерывание от INT0
	OUT	PCIFR,R26		;Сброс запросов на прерывание от PCINT3,PCINT11, PCINT23
	CLR	R9		;Сброс счётчика расширителя таймера Т2
	RETI			;Разрешить глобальные прерывания

;***************************************************************************************

.INCLUDE "Interrupt_r.asm"
.INCLUDE "Time_Usart_r.asm"


